  // quando for 0 o codigo ativa o modo carregamento no usb se for 1 desativo esse modo
//O CALCULO DA BATERIA TEM UM ERRO DE ATE 5%!!!!!!
//sempre conactar a merda do pino SAO no GND para definir o endereço para 0X6A se deixar sem vai ficar oscilando entre o A e B
//calibraçao +- 20 segundos
//filtro complementar adicionado
//media smooth aumentado para 5 amostras
//colocar o monitor serial em 150200 baud

// imagens para o display

static const unsigned char PROGMEM image_bluetooth_bits[] = { 0x00, 0x03, 0x00, 0x00, 0x00, 0x03, 0x00, 0x00, 0x00, 0x0c, 0xc0, 0x00, 0x00,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 0x00, 0x00 };
static const unsigned char PROGMEM image_bluetooth_connected_bits[] = { 0x00, 0x03, 0x00, 0x00, 0x00, 0x03, 0x00, 0x00, 0x00, 0x0c, 0xc0, 0x00, 0x00,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 0x00, 0x00 };
static const unsigned char PROGMEM image_operation_warning_bits[] = { 0x00, 0x00, 0x00, 0x00, 0x00, 0x00, 0x00, 0x00, 0x00, 0x03, 0xc0, 0x00, 0x00,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 0x00, 0x00 };
static const unsigned char PROGMEM image_Layer_5_bits[] = { 0x7f, 0xff, 0xff, 0xff, 0xff, 0xff, 0xff, 0xff, 0xff, 0xff, 0xff, 0xff, 0xff,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 0xff, 0xfe };
static const unsigned char PROGMEM image_download_bits[] = { 0x00, 0x02, 0x00, 0x0f, 0xe4, 0xfe, 0x10, 0x0c, 0x01, 0x10, 0x08, 0x01, 0x70,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 0x00, 0x00 };
static const unsigned char PROGMEM image_Layer_9_bits[] = { 0xff, 0xfc, 0xff, 0xfc, 0xff, 0xfc, 0xff, 0xfc, 0xff, 0xfc, 0xff, 0xfc, 0xff,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 0xff, 0xfc };
static const unsigned char PROGMEM image_hand_pointer_bits[] = { 0x00, 0xc0, 0x00, 0x00, 0xc0, 0x00, 0x03, 0x30, 0x00, 0x03, 0x30, 0x00, 0x03,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 0xc0, 0x30 };
static const unsigned char PROGMEM image_battery_charging_bits[] = { 0x00, 0x00, 0x00, 0x0c, 0x00, 0x00, 0x00, 0x00, 0x00, 0x0c, 0x00, 0x00, 0x00,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 0x00, 0x00 };

//declarando variaveis
int charging = 0;
int indice_bateria = 0;
int lastDisplayTime = 0;
const int N_LEITURAS = 50;  // <- Mexer aqui para mudar o número de médias
int percentagemOld[N_LEITURAS] = { 0 };
const float R1 = 99.1;
const float R2 = 98.8;
const float VOLTAGEM_MAXIMA = 3.95;
const float VOLTAGEM_MINIMA = 3;
const float FATOR_DIVISOR = (R1 + R2) / R2;
int16_t roll2 = 0;
int16_t pitch2 = 0;
int botao = 0;
float tensaobatt = 0.0;

// bibliotecas

#include <Wire.h>
#include <SparkFunLSM6DS3.h>
#include <BLEDevice.h>
#include <BLEServer.h>
#include <BLEUtils.h>
#include <BLE2902.h>
#include <Adafruit_GFX.h>
#include <Adafruit_SH110X.h>



#define SERVICE_UUID "12345678-1234-1234-1234-123456789abc"
#define CHARACTERISTIC_UUID "abcd1234-5678-90ab-cdef-123456789abc"
#define ROLL_CHAR_UUID "87654321-4321-4321-4321-cba987654321"  // (BLE)
#define PITCH_CHAR_UUID "11111111-2222-3333-4444-555555555555"
#define AX_CHAR_UUID "00000001-aaaa-bbbb-cccc-000000000001"
#define AY_CHAR_UUID "00000001-aaaa-bbbb-cccc-000000000002"
#define AZ_CHAR_UUID "00000001-aaaa-bbbb-cccc-000000000003"
#define GX_CHAR_UUID "00000001-aaaa-bbbb-cccc-000000000004"
#define GY_CHAR_UUID "00000001-aaaa-bbbb-cccc-000000000005"
#define GZ_CHAR_UUID "00000001-aaaa-bbbb-cccc-000000000006"
#define PI 3.14159265358979323846
#define i2c_Address 0x3c
#define SCREEN_WIDTH 128      //OLED display width, in pixels   (DISPLAY)
#define SCREEN_HEIGHT 64      //OLED display height, in pixels
#define OLED_RESET -1         //QT-PY / XIAO
#define LSM6DS3_ADDRESS 0x6A  //(ACELEROMETRO)
#define BOTAO1_PIN 8
#define BOTAO2_PIN 9


// caracteristicas do BLE


bool deviceConnected = false;
BLECharacteristic *pCharacteristic;
BLECharacteristic *pRollCharacteristic;
BLECharacteristic *pPitchCharacteristic;
BLECharacteristic *pAxCharacteristic;
BLECharacteristic *pAyCharacteristic;
BLECharacteristic *pAzCharacteristic;
BLECharacteristic *pGxCharacteristic;
BLECharacteristic *pGyCharacteristic;
BLECharacteristic *pGzCharacteristic;



class MyServerCallbacks : public BLEServerCallbacks {
  void onConnect(BLEServer *pServer) {
    deviceConnected = true;
  }
  void onDisconnect(BLEServer *pServer) {
    deviceConnected = false;
  }
};

LSM6DS3 sensor(I2C_MODE, LSM6DS3_ADDRESS);
//display
Adafruit_SH1106G display(SCREEN_WIDTH, SCREEN_HEIGHT, &Wire, OLED_RESET);


// correção dos valores
float axfix = 0.00;  //--]
float ayfix = 0.00;  //  ]-acelerometro
float azfix = 0.00;  //--]
float gxfix = 0.00;  //--]
float gyfix = 0.00;  //  ]-giroscopio
float gzfix = 0.00;  //--]
//mexer aq se for modificar a media
//N d medias↓     ↓  ↓  ↓  ↓ (adicionar ou tirar zero)
float axOld[7] = { 0, 0, 0, 0, 0, 0, 0 };  // acelerometro x
float ayOld[7] = { 0, 0, 0, 0, 0, 0, 0 };  // acelerometro y
float azOld[7] = { 0, 0, 0, 0, 0, 0, 0 };  // acelerometro z
float gxOld[7] = { 0, 0, 0, 0, 0, 0, 0 };  // giroscopio x
float gyOld[7] = { 0, 0, 0, 0, 0, 0, 0 };  // giroscopio y
float gzOld[7] = { 0, 0, 0, 0, 0, 0, 0 };  // giroscopio z
int i = 0;

unsigned long lastTime = 0;  // para calcular o dt (filtro de kalman)

// suavização dos valores
float smooth(float old[], float novo) {
  old[i] = novo;                                                              // guarda o novo
  return (old[0] + old[1] + old[2] + old[3] + old[4] + old[5] + old[6]) / 7;  // média dos 7 valores
  //mexer aq para aumentar a media  ↑              ↑
}

void fixsensor() {
  calibracaodisplay();

  // --- BARRA DE PROGRESSO (Ajustada) ---
  // Caixa (Borda):
  // X=10 (Centralizado), Y=56 (Mais para cima), Largura=108, Altura=4
  display.drawRect(10, 56, 108, 4, 1);
  display.display();

  Serial.println("MANTENHA O SENSOR PARADO");

  float somaAX = 0, somaAY = 0, somaAZ = 0;
  float somaGX = 0, somaGY = 0, somaGZ = 0;

  for (int n = 0; n < 5000; n++) {
    somaAX += sensor.readFloatAccelX();
    somaAY += sensor.readFloatAccelY();
    somaAZ += sensor.readFloatAccelZ();
    somaGX += sensor.readFloatGyroX();
    somaGY += sensor.readFloatGyroY();
    somaGZ += sensor.readFloatGyroZ();

    delay(2);

    if (n % 100 == 0) {
      
      int larguraBarra = map(n, 0, 4999, 0, 106);
      display.fillRect(11, 57, larguraBarra, 2, 1);

      display.display();
    }
  }


  display.fillRect(11, 57, 106, 2, 1);
  display.display();

  // Seus cálculos de média continuam iguais...
  axfix = somaAX / 5000;
  ayfix = somaAY / 5000;
  azfix = somaAZ / 5000 - 1;
  gxfix = somaGX / 5000;
  gyfix = somaGY / 5000;
  gzfix = somaGZ / 5000;

  Serial.println("Pronto");
}

void setup() {
  sensor.begin();
  sensor.settings.accelRange = 4;
  display.begin(i2c_Address, true);
  Serial.begin(115200);
  
  
  pinMode(10, INPUT); // Pino do Carregador (Divisor de Tensão)
  pinMode(A0, INPUT); // Leitura da Bateria
  pinMode(BOTAO1_PIN, INPUT_PULLUP);
  pinMode(BOTAO2_PIN, INPUT_PULLUP);

  
  if (digitalRead(10) == LOW || Serial) {
     esperar();
  }

  BLESETUP();
  connectble(); //
  
  // Loop de espera do Bluetooth (com saída de emergência para carregador)
  while (!deviceConnected) {
    delay(100);
    battery(); // Mantém a leitura da bateria atualizada

    // SE CONECTAR O CABO PARA O LOOP
    if (digitalRead(10) == HIGH && !Serial) { 
      break; // Sai do while
    }
  }

  
  if (deviceConnected && (digitalRead(10) == LOW || Serial)) {
    display.clearDisplay();
    conectado(); //
    delay(2000); // Mostra a mensagem por 2 segundos
  }

 
  display.clearDisplay();
  Serial.begin(115200); //inicia a comunicaçao serial

  
  // Verifica o sensor
  if (sensor.begin() != 0) { 
    exibirErroSensor();
    Serial.println("Sensor LSM6DS3 não encontrado."); //
    while (1); // Trava se não achar o sensor
  }
  Serial.println("Sensor OK");
  display.display();

 
  if (digitalRead(10) == LOW || Serial) { 
    fixsensor(); 
  }

  display.clearDisplay();
  display.setTextColor(SH110X_WHITE); //
}  // fim do setup


void loop() {
  
  digitalRead(10);
  battery();

  if (digitalRead(10) == HIGH && !Serial) {
    display.clearDisplay();
    display.drawBitmap(40, 5, image_battery_charging_bits, 48, 32, 1);
    display.setTextColor(1);
    display.setTextWrap(false);
    display.setCursor(35, 40);
    display.print("CARREGANDO");
    display.setCursor(59, 51);
    display.print(String(tensaobatt) + "V");
    display.setCursor(69, 51);
    display.display();



  } else {

    veriqBLE();
    float tempC = sensor.readTempC();
    float ax = sensor.readFloatAccelX() - axfix;  // pega o valor ax e subtrai pelo valor corrigido
    float ay = sensor.readFloatAccelY() - ayfix;  // pega o valor ay e subtrai pelo valor corrigido
    float az = sensor.readFloatAccelZ() - azfix;  // pega o valor az e subtrai pelo valor corrigido
    float gx = sensor.readFloatGyroX() - gxfix;   // pega o valor gx e subtrai pelo valor corrigido
    float gy = sensor.readFloatGyroY() - gyfix;   // pega o valor gy e subtrai pelo valor corrigido
    float gz = sensor.readFloatGyroZ() - gzfix;   // pega o valor gz e subtrai pelo valor corrigido

    // suavização dos valores (valores antigos, novos valores)
    ax = smooth(axOld, ax);
    ay = smooth(ayOld, ay);
    az = smooth(azOld, az);
    gx = smooth(gxOld, gx);
    gy = smooth(gyOld, gy);
    gz = smooth(gzOld, gz);

    // Atualiza o índice 'i' de 0 a 2 de forma cíclica (0 → 1 → 2 → 0 → 1 → 2 ...)
    // Usado para armazenar os 7 valores mais recentes na suavização !!!!! alterar aq tambem se mudar a quantidade de amostras na media !!!!!!
    i = (i + 1) % 7;

    //----------------------------------pesquisar sobre o filtro kalman utizando giroscopio + acelerometro----------------------------------

    float rollAcc = atan2(ay, sqrt(ax * ax + az * az)) * 180.0 / PI;
    float pitchAcc = atan2(-ax, sqrt(ay * ay + az * az)) * 180.0 / PI;

    //filtro complementar
    static float roll = 0;
    static float pitch = 0;

    unsigned long now = millis();
    float dt = (now - lastTime) / 1000.0;
    if (dt <= 0 || dt > 0.1) dt = 0.01;  // segurança contra valores ruins
    lastTime = now;

    // peso entre giroscópio e acelerômetro (ajusta esse valor)
    const float alpha = 0.90;

    roll = alpha * (roll + gx * dt) + (1 - alpha) * rollAcc;
    pitch = alpha * (pitch + gy * dt) + (1 - alpha) * pitchAcc;



    roll2 = constrain((int)roll, -99, 99);
    pitch2 = constrain((int)pitch, -99, 99);

    // mostra os valores no serial monitor
    /* Serial.print("Acel X: ");
  Serial.print(ax);
  Serial.print(" Y: ");
  Serial.print(ay);
  Serial.print(" Z: ");
  Serial.println(az);
  Serial.print("Giro X: ");
  Serial.print(gx);
  Serial.print(" Y: ");
  Serial.print(gy);
  Serial.print(" Z: ");
  Serial.println(gz);
*/
    // imprime os valores de rotação e inclinação

    /*
    Serial.print("Rotação lateral: ");
    Serial.print(roll);  // rotação lateral (Roll)
    Serial.print("°  ");
    Serial.print("Inclinação: ");
    Serial.print(pitch);  // inclinação (Pitch)
    Serial.println("°");
*/

    /*   //Serial Plotter
    Serial.print(roll2);  // Rotação
    Serial.print("\t");
    Serial.print(pitch2);  // Inclinação
    Serial.println();
    // leitura(); // para ver os valores bruto
*/
    BLE(ax, ay, az, gx, gy, gz);

    int percentagem_atual = battery();

    display.clearDisplay();

    // Layer 5
    display.drawBitmap(1, 43, image_Layer_5_bits, 128, 21, 1);

    // Layer 1
    display.setTextColor(1);
    display.setTextSize(2);
    display.setTextWrap(false);
    display.setCursor(4, 4);
    display.print("ROLL:");

    // Layer 2
    display.setCursor(4, 25);
    display.print("PITCH:");

    // Layer 3
    display.setCursor(75, 3);
    display.print(roll2);

    // Layer 4
    display.setCursor(75, 25);
    display.print(pitch2);

    // download
    display.drawBitmap(44, 46, image_download_bits, 24, 16, 0);

    // Layer 9
    display.setTextColor(0);
    display.setTextSize(1);
    display.setCursor(88, 50);
    display.print("%");
    display.setCursor(70, 50);
    display.print(percentagem_atual);

    // Layer 9
    display.drawBitmap(114, 0, image_Layer_9_bits, 14, 43, 1);
    display.display();
    if (millis() - lastDisplayTime > 50) {
      display.display();
      lastDisplayTime = millis();
    }
  }
}
